/ {
    &encoder0 {
        compatible = "alps,ec11";
        steps = <30>;                   // one step per detent (half of default)
        triggers-per-rotation = <30>;   // one trigger per detent
        status = "okay";
    };

    &encoder1 {
        compatible = "alps,ec11";
        steps = <30>;
        triggers-per-rotation = <30>;
        status = "okay";
    };
};
